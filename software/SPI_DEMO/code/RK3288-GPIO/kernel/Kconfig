## software/SPI_DEMO/code/RK3288-GPIO/kernel/Kconfig
```kconfig
config	PRINTER_POWER_MODULE
	bool "PRINTER POWER MODULE support"
	default y
	help
		Enable PRINTER POWER MODULE support
```

## software/SPI_DEMO/code/RK3288-GPIO/kernel/script_modify/Kconfig
```kconfig
source "drivers/misc/pax/printer_powerctl/Kconfig"
source "drivers/misc/pax/PosVcom/Kconfig"
source "drivers/misc/pax/fingerprint/Kconfig"
```
